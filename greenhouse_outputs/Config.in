## greenhouse_outputs/Config.in
```kconfig
config BR2_PACKAGE_GREENHOUSE_OUTPUTS
	bool greenhouse_outputs
	help
		technologie avancee
```

## temperature_sensor_spi/Config.in
```kconfig
config BR2_PACKAGE_TEMPERATURE_SENSOR_SPI
	bool temperature_sensor_spi
	help
		technologie avancee
```
